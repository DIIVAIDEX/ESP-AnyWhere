## components/SoftAP_STA/Kconfig.projbuild
```kconfig
menu "Wi-Fi Config"
    menu "SoftAP Config"
		config WIFI_SSID
		    string "WiFi SSID"
		    default "ESP-AnyWhere"
		    help
		        SSID (network name) for the example to connect to.
		config WIFI_PASSWORD
		    string "WiFi Password"
		    default "12345678"
		    help
		        WiFi password (WPA or WPA2) for the example to use.
		config WIFI_CHANNEL
		    int "WiFi Channel"
		    range 1 14
		    default 6
		    help
		        WiFi channel (network channel) for the example to use.
		choice
		    prompt "WiFi Bandwidth"
		    default WIFI_BANDWIFTH_40
		
		    config WIFI_BANDWIFTH_20
		        bool "20MHz"
		    config WIFI_BANDWIFTH_40
		        bool "40MHz"
		endchoice
		config MODEM_WIFI_MAX_STA
		    int "Maximal STA connections"
		    default 10
		    help
		        Max number of the STA connects to AP.
		config WIFI_DEFAULT_DNS
		    string  "WiFi softap default DNS address"
		    default "77.88.8.8"
    endmenu
	    
    menu "STA Config"
        comment "STA Configuration"

        config WIFI_REMOTE_AP_SSID
            string "WiFi Remote AP SSID"
            default "SomeSSID"
            help
                SSID (network name) for the example's sta to connect to.

        config WIFI_REMOTE_AP_PASSWORD
            string "WiFi Remote AP Password"
		    default "12345678"
            help
                WiFi password for the example to use.

        config MAXIMUM_STA_RETRY
            int "Maximum retry"
            default 5
            help
                Set the maximum retry value to prevent the station from continuously
                attempting to reconnect to the Access Point (AP) when the AP doesn't exist.

        choice ESP_WIFI_SCAN_AUTH_MODE_THRESHOLD
            prompt "WiFi Scan auth mode threshold"
            default ESP_WIFI_AUTH_WPA2_PSK
            help
                The weakest authmode to accept in the scan mode.
                This value defaults to ESP_WIFI_AUTH_WPA2_PSK in case password is present
                and ESP_WIFI_AUTH_OPEN is used. Please select ESP_WIFI_AUTH_WEP / ESP_WIFI_AUTH_WPA_PSK
                in case AP is operating in WEP / WPA mode.

            config ESP_WIFI_AUTH_OPEN
                bool "OPEN"
            config ESP_WIFI_AUTH_WEP
                bool "WEP"
            config ESP_WIFI_AUTH_WPA_PSK
                bool "WPA PSK"
            config ESP_WIFI_AUTH_WPA2_PSK
                bool "WPA2 PSK"
            config ESP_WIFI_AUTH_WPA_WPA2_PSK
                bool "WPA/WPA2 PSK"
            config ESP_WIFI_AUTH_WPA3_PSK
                bool "WPA3 PSK"
            config ESP_WIFI_AUTH_WPA2_WPA3_PSK
                bool "WPA2/WPA3 PSK"
            config ESP_WIFI_AUTH_WAPI_PSK
                bool "WAPI PSK"
        endchoice
    endmenu
endmenu
```

## components/esp_wireguard/Kconfig
```kconfig
menu "WireGuard"
    menu "Connection Config"
		config WG_PRIVATE_KEY
		    string "Private Key"
		    default "kP+BOf33eIEocYB6dyoiNji8Up7Smv8ehjejVGJzdkE="
		config WG_LOCAL_IP_ADDRESS
		    string "Local IP Address"
		    default "172.16.4.8"
		config WG_LOCAL_IP_NETMASK
		    string "Local Mask"
		    default "255.255.255.0"
		config WG_LOCAL_PORT
		    int "Local Port"
		    default 51820
		    
		config WG_PEER_PUBLIC_KEY
		    string "Public Key"
		    default "Ef3PXKahmRGphGyIWXqs37uqOODj9IlRaKXWNppZJRE="
		config WG_PEER_ADDRESS
		    string "Peer Address"
		    default "your.server"
		config WG_PEER_PORT
		    int "Peer Port"
		    default 51820
		config WG_PERSISTENT_KEEP_ALIVE
		    int "Persistent Keep Alive"
		    default 60
    endmenu

	choice WIREGUARD_ESP_ADAPTER_SELECTION
	    prompt "TCP/IP adapter to use"
	    default WIREGUARD_ESP_NETIF
	    config WIREGUARD_ESP_TCPIP_ADAPTER
	        bool "TCP/IP Adapter (pre esp-idf v4.1, ESP8266 RTOS SDK)"
	    config WIREGUARD_ESP_NETIF
	        bool "ESP-NETIF"
	endchoice
	
	config WIREGUARD_MAX_PEERS
	    int "Max number of peers"
	    default 1
	
	config WIREGUARD_MAX_SRC_IPS
		int "Max number of SRC IP addresses"
		default 2
	
	config MAX_INITIATIONS_PER_SECOND
	    int "Per device limit on accepting (valid) initiation requests"
	    default 2
	    help
	        Per device limit on accepting (valid) initiation requests - per peer.
	choice WIREGUARD_x25519_IMPLEMENTATION
	    prompt "x25519 implementation to use"
	    default WIREGUARD_x25519_IMPLEMENTATION_DEFAULT
	    config WIREGUARD_x25519_IMPLEMENTATION_DEFAULT
	        bool "Default (originally from wireguard-lwip)"
	    config WIREGUARD_x25519_IMPLEMENTATION_NACL
	        bool "NaCL"
	endchoice
endmenu
```
